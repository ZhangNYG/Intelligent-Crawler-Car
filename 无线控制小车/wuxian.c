#include <reg51.h>
sbit p2_0 = P2^0;
sbit p2_1 = P2^1;
sbit p2_2 = P2^2;
sbit p2_3 = P2^3;
sbit p1_0 = P1^0;
sbit p1_1 = P1^1;
sbit p1_2 = P1^2;
sbit p1_3 = P1^3;
/*******************************共阳LED段码表*******************************/
unsigned char code table[]={0xc0,0xf9,0xa4,0xb0,0x99,0x92,0x82,0xf8,0x80,0x90};
/*******************************定义全局变量********************************/
/*********************************端口定义**********************************/
						//接收到的数据
/****************************************************************************
函数功能:数码管扫描延时子程序
入口参数:
出口参数:
****************************************************************************/
void delay(int a)
{
	int k,j;
	for(k=a;k>0;k--)
	for(j=0;j<125;j++);

}
/****************************************************************************
函数功能:LED数码管显示程序
入口参数:k
出口参数:
****************************************************************************/
void display(int a)
{
unsigned int k=200;

while  (k--)
{
p2_0=0;p2_1=1;p2_2=1;p2_3=1;
P0 =table[a/1000%10];
delay(2);


p2_0=1;p2_1=0;p2_2=1;p2_3=1;
P0 =table[a/100%10];
delay(2);

p2_0=1;p2_1=1;p2_2=0;p2_3=1;
P0 =table[a/10%10];
delay(2);

p2_0=1;p2_1=1;p2_2=1;p2_3=0;
P0 =table[a%10];
delay(2);
}							
}
/****************************************************************************
函数功能:主程序
入口参数:
出口参数:
****************************************************************************/
void main(void)
{
	char datavalue;
						
  							//置输入状态
	while(1)
	{
						//端口初始化
	 

		if(p1_0==1)//A
	{ 	datavalue=0x01;
			display(datavalue);  	}
		if(p1_1==1)//B
		{datavalue=0x02;
			display(datavalue); 	
		 }
		if(p1_2==1)//C
		{datavalue=0x03;
			display(datavalue);	}
		if(p1_3==1)//d
		{
		datavalue=0x04;
		    display(datavalue);		//将读到的数显示
		 }

		
	}
}

